## htfg/Kconfig
```kconfig
# SPDX-License-Identifier: GPL-2.0-only
#
# 放置位置：内核树的 drivers/htfg/Kconfig

config HTFG
	bool "HTFG kernel-side channel"
	default y
	help
	  Minimal kernel-side channel used by the HTFG UI data reader.

	  Provides a magic prctl() entry point: a scalar ping (step 1) plus
	  three read-only primitives (step 2) -- read a range of another
	  process's memory, find a main-process pid by package name, and
	  enumerate a process's VMAs.  Caller identity is either a small
	  tool identity whitelist (uid 0/2000 -- root/shell CLI use only;
	  never an app uid) or APK signing-certificate fingerprint
	  pinning: the SHA-256 of the first certificate in the caller's
	  installed base.apk v2 signing block must match a compiled-in
	  fingerprint (any package name; the signing key is the
	  credential).  This is pinning, not full APK signature
	  verification: it relies on PackageManager's install-time
	  verification and on installed APKs under /data/app being
	  immutable.

	  Step 5 adds TOUCH_DEV / TOUCH_SEND (op 5/6): query the touchscreen
	  input device and inject touch events into its input-core pipeline
	  (the only side-effect primitive; it writes no process memory and
	  no files).

	  If unsure, say N.
```

## htfg/screen_test/Kconfig
```kconfig
# SPDX-License-Identifier: GPL-2.0
#
# HTFG_Kernel_Original_Screenshot Stage 2A test driver.
# TEST-ONLY: this option must never be enabled in a shipping kernel.

config HTFG_SCREEN_TEST
	bool "HTFG Stage 2 screen capture test driver (test kernels only)"
	depends on DRM && DEBUG_FS && KALLSYMS_ALL
	default y
	help
	  Independent built-in test driver for the HTFG screenshot feasibility
	  project.  It reaches the vendor mediatek-drm CWB/WDMA helpers through
	  kallsyms_lookup_name(), replaces the stock 128-wide CWB buffers with
	  full-screen MTK GEM framebuffers, and exposes a root-only debugfs node
	  for capture/read.

	  This is a prototype scaffold, not the final HTFG interface.  It does
	  not include HTFG headers, does not register a prctl operation and must
	  not be shipped.
```
